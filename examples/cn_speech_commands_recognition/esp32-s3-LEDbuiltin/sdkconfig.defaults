## examples/cn_speech_commands_recognition/esp32-s3-LEDbuiltin/sdkconfig.defaults
```kconfig
# ESP32-S3 specific configuration
CONFIG_IDF_TARGET="esp32s3"

# Enable UART for logging
CONFIG_ESP_CONSOLE_UART_DEFAULT=y
CONFIG_ESP_CONSOLE_UART_NUM=0
CONFIG_ESP_CONSOLE_UART_BAUDRATE=115200

# Log level
CONFIG_LOG_DEFAULT_LEVEL_INFO=y
CONFIG_LOG_DEFAULT_LEVEL=3

# FreeRTOS configuration
CONFIG_FREERTOS_HZ=1000

# GPIO configuration
CONFIG_GPIO_ESP32_SUPPORT_SWITCH_SLP_PULL=y
```

## examples/cn_speech_commands_recognition/sdkconfig.defaults
```kconfig
CONFIG_PARTITION_TABLE_CUSTOM=y
CONFIG_PARTITION_TABLE_CUSTOM_FILENAME="partitions.csv"
CONFIG_PARTITION_TABLE_FILENAME="partitions.csv"
CONFIG_PARTITION_TABLE_OFFSET=0x8000


# Custom Chinese Speech Commands
CONFIG_CN_SPEECH_COMMAND_ID1="da kai qian bei xiang"
CONFIG_CN_SPEECH_COMMAND_ID2="da kai cang men"
CONFIG_CN_SPEECH_COMMAND_ID3="kai xiang"
CONFIG_CN_SPEECH_COMMAND_ID4="bang wo kai deng"
```
